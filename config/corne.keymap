#include <dt-bindings/zmk/keys.h>
#include <dt-bindings/zmk/outputs.h>
#include <dt-bindings/zmk/bt.h>

#include <behaviors.dtsi>

#include "zmk-helpers/helper.h"
#include "keys/36.h"

#include "keys/keys_ru.h"

// global
#define QUICK_TAP_MS 150
#define TAPPING_TERM_MS 200
#define PRIOR_IDLE_MS 150

// home rows
#define HRML(k1,k2,k3,k4) &hml LALT k1   &hml LMETA k2   &hml LSHIFT k3  &hml LCTRL k4
#define HRMR(k1,k2,k3,k4) &hmr RCTRL k1  &hmr RSHIFT k2  &hmr RMETA k3   &hmr RALT k4

// layers
#define BASE 0
#define NUM 1
#define SYM 2
#define FN 3
#define NAV 4
#define GEM 5

// redefined keycodes
#define _LWIN_    &kp LEFT_WIN
#define _RALT_    &kp RIGHT_ALT
#define _SPC_     &kp SPACE
// #define _RET_     &kp RETURN 
#define _CUT_     &kp LG(X)
#define _COPY_    &kp LG(C)
#define _PASTE_   &kp LG(V)

#define _MO_NUM_ &mo NUMBER

#define OUTTOG   &out OUT_TOG // toggle keyboard output bluetooth/usb
#define ___      &trans      //  transparent
#define _x_      &none

#define MEH LC(LS(LALT))

// tap: sticky-shift | shift + tap/ double-tap: caps-word | hold: shift
ZMK_MOD_MORPH(smart_shift,
    bindings = <&sk LSHFT>, <&caps_word>;
    mods = <(MOD_LSFT)>;
)

/* left-hand HRMs */
ZMK_BEHAVIOR(hml, hold_tap,
    flavor = "balanced";
    tapping-term-ms = <TAPPING_TERM_MS>;
    quick-tap-ms = <QUICK_TAP_MS>;
    require-prior-idle-ms = <PRIOR_IDLE_MS>;
    bindings = <&kp>, <&kp>;
    hold-trigger-key-positions = <LEFT_KEYS THUMB_KEYS>;
    hold-trigger-on-release;
)

/* right-hand HRMs */
ZMK_BEHAVIOR(hmr, hold_tap,
    flavor = "balanced";
    tapping-term-ms = <TAPPING_TERM_MS>;
    quick-tap-ms = <QUICK_TAP_MS>;
    require-prior-idle-ms = <PRIOR_IDLE_MS>;
    bindings = <&kp>, <&kp>;
    hold-trigger-key-positions = <RIGHT_KEYS THUMB_KEYS>;
    hold-trigger-on-release;
)

/* left-hand HRM shift */
ZMK_BEHAVIOR(hml_s, hold_tap,
    flavor = "balanced";
    tapping-term-ms = <200>;
    quick-tap-ms = <175>;                // repeat on tap-into-hold
    require-prior-idle-ms = <150>;         // requires PR #1387
    bindings = <&kp>, <&kp>;
    hold-trigger-key-positions = <LEFT_KEYS THUMB_KEYS>;
    // hold-trigger-on-release;             // delay positional check until key-release
)

/* right-hand HRM shift */
ZMK_BEHAVIOR(hmr_s, hold_tap,
    flavor = "balanced";
    tapping-term-ms = <200>;
    quick-tap-ms = <175>;                // repeat on tap-into-hold
    require-prior-idle-ms = <150>;         // requires PR #1387
    bindings = <&kp>, <&kp>;
    hold-trigger-key-positions = <RIGHT_KEYS THUMB_KEYS>;
    // hold-trigger-on-release;             // delay positional check until key-release
)


/ {
  chosen {
    zmk,matrix_transform = &five_column_transform;
  };
};
/ {
  combos {
      compatible = "zmk,combos";
      iu_backspace_combo {
        timeout-ms = <50>; // Adjust as needed
        bindings = <&caps_word>; // Action: Backspace
        key-positions = <RM1 RM2>;
        layers = < BASE >;
      };
      jk_colon_combo {
        timeout-ms = <50>; // Adjust as needed
        bindings = <&smart_shift>; // Action: Backspace
        key-positions = <LM1 LM2>;
        layers = < BASE >;
      };
      game_toggle_combo {
        timeout-ms = <50>;
        bindings = <&tog GEM>;
        key-positions = <RT0 RT4>;
        layers = < BASE GEM >;
      };

      ru_io_combo {
        timeout-ms = <50>;
        bindings = <&kp RU_CYRILLIC_IO>;
        key-positions = <LM4 LT4>;
        layers = < BASE >;
      };
      ru_ha_combo {
        timeout-ms = <50>;
        bindings = <&kp RU_CYRILLIC_HA>;
        key-positions = <RM3 RT3>;
        layers = < BASE >;
      };
      ru_e_combo {
        timeout-ms = <50>;
        bindings = <&kp RU_CYRILLIC_E>;
        key-positions = <RM4 RT4>;
        layers = < BASE >;
      };
      ru_hard_combo {
        timeout-ms = <50>;
        bindings = <&kp RU_CYRILLIC_HARD_SIGN>;
        key-positions = <RB4 RM4>;
        layers = < BASE >;
      };
  };
  behaviors {
    hm: homerow_mods {
      compatible = "zmk,behavior-hold-tap";
      flavor = "balanced";
      tapping-term-ms = <280>;
      quick-tap-ms = <QUICK_TAP_MS>; 
      bindings = <&kp>, <&kp>;
      // label = "HOMEROW_MODS";
      #binding-cells = <2>;
      // hold-trigger-key-positions = <TRIGGER_POS>;
      hold-trigger-on-release;

    };
    SBD: S_BSPC_DEL {
         compatible = "zmk,behavior-mod-morph";
            #binding-cells = <0>;
            bindings = <&kp BSPC>, <&kp DEL>;
            mods = <(MOD_LSFT|MOD_RSFT)>;
    };
    oneshot_esc: oneshot {
          compatible = "zmk,behavior-oneshot";
          label = "OneShot ESC";
          #binding-cells = <0>;
      };
  };

};

/ {
  macros {
    three_0: three_0 {
      compatible = "zmk,behavior-macro";
      #binding-cells = <0>;
      bindings
        = <&macro_tap &kp N0 &kp N0 &kp N0>;
    };
    nine_0: nine_0 {
      compatible = "zmk,behavior-macro";
      #binding-cells = <0>;
      bindings
        = <&macro_tap &kp N0 &kp N0 &kp N0
          &kp N0 &kp N0 &kp N0
          &kp N0 &kp N0 &kp N0>;
    };
  };
};

/ {
  keymap {
    compatible = "zmk,keymap";
    base_layer { 

      bindings = <
        // ╭───────────────────────────────────────────────────────────╮   ╭───────────────────────────────────────────────────────────╮
        // │    Q/Й    │    W/Ц    │    E/У    │    R/К    |    T/Е    │   │    Y/Н    │    U/Г    │    I/Ш    │    O/Щ    │    P/З    │
              &lt FN Q     &kp W       &kp E       &kp R       &kp T           &kp Y       &kp U       &kp I       &kp O      &lt FN P
        // ├────┤Ё├────┼───────────┼───────────┼───────────┼───────────┤   ├───────────┼───────────┼───────────┼────┤Х├────┼────┤Э├────┤
        // │    A/Ф    │    S/Ы    │    D/В    │    F/Д    │    G/А    │   │    H/Р    │    J/О    │    K/Л    │    L/Д    │    '/Ж    │
            HRML(A,          S,          D,          F)      &lt NUM G         &kp H     HRMR(J,         K,          L,        SEMI)
        // ├───────────┼───────────┼───────────┼───────────┼───────────┤   ├───────────┼───────────┼───────────┼───────────┼────┤Ъ├────┤
        // │    Z/Я    │    X/Ч    │    C/С    │    V/М    │    B/И    │   │    N/Т    │    M/Ь    │   ,/;/Б   │   ./:/Ю   │    //,    │
               &kp Z       &kp X       &kp C       &kp V       &kp B           &kp N       &kp M     &kp COMMA    &kp DOT     &kp FSLH
        // ╰───────────┼───────────┼───────────┼───────────┼───────────╯   ╰───────────┼───────────┼───────────┼───────────┼───────────╯
                                     &kp CAPS  &lt NAV TAB &lt NUM SPACE    &kp RETURN  &lt SYM ESC    &SBD 
        //                         │                                   │   │                                   │
        //                         ╰───────────────────────────────────╯   ╰───────────────────────────────────╯
      >;
    };
    number_layer { 

      bindings = <
        // ╭───────────────────────────────────────────────────────────╮   ╭───────────────────────────────────────────────────────────╮
        // │     _     │     _     │     _     │     _     │     _     │   │     _     │     7     │     8     │     9     │     _     │
                _x_         _x_         _x_         _x_         _x_           &nine_0      &kp N7      &kp N8      &kp N9       _x_
        // ├───────────┼───────────┼───────────┼───────────┼───────────┤   ├───────────┼───────────┼───────────┼───────────┼───────────┤
        // │     _     │     _     │     _     │     _     │     _     │   │     _     │     4     │     5     │     6     │     _     │
                ___         ___         ___         ___         ___           &three_0     &kp N4      &kp N5      &kp N6       _x_
        // ├───────────┼───────────┼───────────┼───────────┼───────────┤   ├───────────┼───────────┼───────────┼───────────┼───────────┤
        // │     _     │     _     │     _     │     _     │     _     │   │     0     │     1     │     2     │     3     │     _     │
                _x_         _x_         _x_         _x_         _x_            &kp N0      &kp N1      &kp N2      &kp N3       _x_
        // ╰───────────┼───────────┼───────────┼───────────┼───────────╯   ╰───────────┼───────────┼───────────┼───────────┼───────────╯
                                        ___         _x_         ___             ___         ___         ___ 
        //                         │                                   │   │                                   │
        //                         ╰───────────────────────────────────╯   ╰───────────────────────────────────╯
      >;
    };
    symbol_layer {

      bindings = <
        // ╭───────────────────────────────────────────────────────────╮   ╭───────────────────────────────────────────────────────────╮
        // │     !     │     @     │     #     │     $     │     %     │   │     ^     │     &     │     *     │     `     │     ~     │
              &kp EXCL    &kp AT     &kp HASH    &kp DLLR   &kp PRCNT        &kp CARET   &kp AMPS    &kp STAR    &kp GRAVE  &kp TILDE
        // ├───────────┼───────────┼───────────┼───────────┼───────────┤   ├───────────┼───────────┼───────────┼───────────┼───────────┤
        // │     "     │     [     │     {     │     (     │     <     │   │     /     │     -     │     =     │     :     │     ;     │
              &kp DQT     &kp LBKT    &kp LBRC    &kp LPAR    &kp LT         &kp FSLH    &kp MINUS   &kp EQUAL   &kp COLON   &kp SEMI
        // ├───────────┼───────────┼───────────┼───────────┼───────────┤   ├───────────┼───────────┼───────────┼───────────┼───────────┤
        // │     '     │     ]     │     }     │     )     │     >     │   │     \     │     _     │     +     │     |     │     ?     │
              &kp SQT     &kp RBKT    &kp RBRC    &kp RPAR    &kp GT         &kp BSLH    &kp UNDER   &kp PLUS     &kp PIPE   &kp QMARK
        // ╰───────────┼───────────┼───────────┼───────────┼───────────╯   ╰───────────┼───────────┼───────────┼───────────┼───────────╯
                                        ___         _x_         _x_             _x_         _x_         _x_
        //                         │                                   │   │                                   │
        //                         ╰───────────────────────────────────╯   ╰───────────────────────────────────╯
      >;
    };
    fn_layer { 

      bindings = <
        // ╭───────────────────────────────────────────────────────────╮   ╭───────────────────────────────────────────────────────────╮
        // │     _     │     _     │     _     │     _     │     _     │   │     _     │     _     │     _     │     _     │     _     │
              &sl BASE  &out OUT_USB &out OUT_BLE   _x_     &bt BT_CLR         &kp F10     &kp F7      &kp F8      &kp F9  &kp C_AL_LOCK
        // ├───────────┼───────────┼───────────┼───────────┼───────────┤   ├───────────┼───────────┼───────────┼───────────┼───────────┤
        // │bluetooth 0│bluetooth 1│bluetooth 2│bluetooth 3│bluetooth 4│   │     _     │     _     │     _     │     _     │     _     │
            &bt BT_SEL 0 &bt BT_SEL 1 &bt BT_SEL 2 &bt BT_SEL 3 &bt BT_SEL 4   &kp F11     &kp F4      &kp F5      &kp F6     &kp F13
        // ├───────────┼───────────┼───────────┼───────────┼───────────┤   ├───────────┼───────────┼───────────┼───────────┼───────────┤
        // │     _     │     _     │     _     │     _     │     _     │   │     _     │           │           │     _     │     _     │
            &bootloader     _x_         _x_         _x_        _x_             &kp F12     &kp F1      &kp F2      &kp F3   &bootloader
        // ╰───────────┼───────────┼───────────┼───────────┼───────────╯   ╰───────────┼───────────┼───────────┼───────────┼───────────╯
                                        ___         ___         ___             ___         ___         ___ 
        //                         │                                   │   │                                   │
        //                         ╰───────────────────────────────────╯   ╰───────────────────────────────────╯
      >;
    };
    navigation_layer { 

      bindings = <
        // ╭───────────────────────────────────────────────────────────╮   ╭───────────────────────────────────────────────────────────╮
        // │     _     │     _     │     _     │     _     │     _     │   │     _     │     _     │     _     │     _     │     _     │
            &kp C_PREV &kp C_VOL_DN &kp C_VOL_UP &kp C_NEXT   &kp C_PP          _x_     &kp C_MENU &kp C_BRI_DN &kp C_BRI_UP &kp PSCRN
        // ├───────────┼───────────┼───────────┼───────────┼───────────┤   ├───────────┼───────────┼───────────┼───────────┼───────────┤
        // │     _     │     _     │     _     │     _     │     _     │   │     _     │     _     │     _     │     _     │     _     │
             HRML(HOME,  PAGE_DOWN,   PAGE_UP,      END)        _x_             _x_      HRMR(LEFT,     DOWN,       UP,        RIGHT)
        // ├───────────┼───────────┼───────────┼───────────┼───────────┤   ├───────────┼───────────┼───────────┼───────────┼───────────┤
        // │     _     │     _     │     _     │     _     │     _     │   │     _     │     _     │     _     │     _     │     _     │
             &kp LG(N1)  &kp LG(N2)  &kp LG(N3)  &kp LG(N4)  &kp LG(N5)         _x_         _x_         _x_         _x_       &kp DEL
        // ╰───────────┼───────────┼───────────┼───────────┼───────────╯   ╰───────────┼───────────┼───────────┼───────────┼───────────╯
                                        ___         _x_         ___             ___         ___         ___
        //                         │                                   │   │                                   │
        //                         ╰───────────────────────────────────╯   ╰───────────────────────────────────╯
      >;
    };
    game_layer { 

      bindings = <
        // ╭───────────────────────────────────────────────────────────╮   ╭───────────────────────────────────────────────────────────╮
        // │    esc    │     Q     │     W     │     E     │    R      │   │     T     │     Y     │     U     │     I     │     O     │
              &kp ESC      &kp Q       &kp W       &kp E       &kp R           &kp T       &kp Y       &kp U       &kp I       &kp O
        // ├───────────┼───────────┼───────────┼───────────┼───────────┤   ├───────────┼───────────┼───────────┼ ──────────┼───────────┤
        // │   shift   │     A     │     S     │     D     │     F     │   │     G     │     H     │     J     │     K     │     L     │
             &kp LSHIFT    &kp A       &kp S       &kp D       &kp F           &kp G       &kp H       &kp J       &kp K       &kp L
        // ├───────────┼───────────┼───────────┼───────────┼───────────┤   ├───────────┼───────────┼───────────┼───────────┼───────────┤
        // │   ctrl    │     Z     │     X     │     C     │     V     │   │     B     │     N     │     M     │    ,/;    │ minecraft │
             &kp LCTRL     &kp Z       &kp X       &kp C       &kp V           &kp B       &kp N       &kp M       &kp P      &kp F3
        // ╰───────────┼───────────┼───────────┼───────────┼───────────╯   ╰───────────┼───────────┼───────────┼───────────┼───────────╯
                                     &kp RETURN   &kp TAB    &kp SPACE       &kp RETURN   &kp ESC    &kp BSPC 
        //                         │                                   │   │                                   │
        //                         ╰───────────────────────────────────╯   ╰───────────────────────────────────╯
      >;
    };
  };
};

//                                  Template for new layers all keys are transparent
//      ╭───────────────────────────────────────────────────────────╮   ╭───────────────────────────────────────────────────────────╮
//      │     _     │     _     │     _     │     _     │     _     │   │     _     │     _     │     _     │     _     │     _     │
//           ___         ___         ___         ___         ___             ___         ___         ___         ___         ___
//      ├───────────┼───────────┼───────────┼───────────┼───────────┤   ├───────────┼───────────┼───────────┼───────────┼───────────┤
//      │     _     │     _     │     _     │     _     │     _     │   │     _     │     _     │     _     │     _     │     _     │
//           ___         ___         ___         ___         ___             ___         ___         ___         ___         ___
//      ├───────────┼───────────┼───────────┼───────────┼───────────┤   ├───────────┼───────────┼───────────┼───────────┼───────────┤
//      │     _     │     _     │     _     │     _     │     _     │   │     _     │     _     │     _     │     _     │     _     │
//           ___         ___         ___         ___         ___             ___         ___         ___         ___         ___
//      ╰───────────┼───────────┼───────────┼───────────┼───────────╯   ╰───────────┼───────────┼───────────┼───────────┼───────────╯
//                                   ___         ___         ___            ___         ___         ___
//                              │                                   │   │                                   │
//                              ╰───────────────────────────────────╯   ╰───────────────────────────────────╯
//



// vim:ft=cpp
